## defconfig
```kconfig
BR2_arm=y
BR2_cortex_a9=y
BR2_ARM_ENABLE_NEON=y
BR2_ARM_ENABLE_VFP=y
BR2_ARM_FPU_VFPV3=y
BR2_TOOLCHAIN_BUILDROOT_GLIBC=y
BR2_KERNEL_HEADERS_4_4=y
BR2_TARGET_GENERIC_GETTY_PORT="ttyPS0"
BR2_LINUX_KERNEL=y
BR2_LINUX_KERNEL_CUSTOM_GIT=y
BR2_LINUX_KERNEL_CUSTOM_REPO_URL="https://github.com/Digilent/linux-digilent"
BR2_LINUX_KERNEL_CUSTOM_REPO_VERSION="digilent-v4.4"
BR2_LINUX_KERNEL_DEFCONFIG="xilinx_zynq"
BR2_LINUX_KERNEL_UIMAGE=y
BR2_LINUX_KERNEL_UIMAGE_LOADADDR="0x8000"
BR2_LINUX_KERNEL_DTS_SUPPORT=y
BR2_LINUX_KERNEL_INTREE_DTS_NAME="zynq-artyz7"
BR2_TARGET_ROOTFS_CPIO=y
BR2_TARGET_ROOTFS_CPIO_UIMAGE=y
BR2_TARGET_UBOOT=y
BR2_TARGET_UBOOT_BOARDNAME="zynq_artyz7"
BR2_TARGET_UBOOT_CUSTOM_GIT=y
BR2_TARGET_UBOOT_CUSTOM_REPO_URL="https://github.com/Digilent/u-boot-digilent"
BR2_TARGET_UBOOT_CUSTOM_REPO_VERSION="digilent-v2016.07"
BR2_TARGET_UBOOT_NEEDS_DTC=y
BR2_TARGET_UBOOT_NEEDS_OPENSSL=y
BR2_TARGET_UBOOT_FORMAT_IMG=y
BR2_TARGET_UBOOT_SPL=y
BR2_TARGET_UBOOT_SPL_NAME="spl/boot.bin"
```

## package/zynq-firmware/Config.in
```kconfig
config BR2_PACKAGE_ZYNQ_FW
	bool "zynq_fw"
	help
		This package contains the firmware build for
		a zynq fpga.
if BR2_PACKAGE_ZYNQ_FW
config BR2_ZYNQ_FIRMWARE_PATH 
	string "Zynq Firmware path"
	help
		Path to the zynq firmware directory
endif
```

## user/multi-with-fpga.its
```
/*
 * U-Boot uImage source file with multiple kernels, ramdisks and FDT blobs
 * This example makes use of the 'loadables' field
 */

/dts-v1/;

/ {
	description = "Configuration to load fpga before Kernel";
#address-cells = <1>;

	images {
		fdt@0 {
			description = "artyz7";
			data = /incbin/("./devicetree.dtb");
			type = "flat_dt";
			arch = "arm";
			compression = "none";
			load = <0x10000000>;
			hash@1 {
				algo = "md5";
			};
		};

		fpga@0 {
			description = "FPGA";
			data = /incbin/("./fpga.bit");
			type = "fpga";
			arch = "arm";
			compression = "none";
			load = <0x30000000>;
			hash@1 {
				algo = "md5";
			};
		};

		linux_kernel@0 {
			description = "Linux";
			data = /incbin/("./Image");
			type = "kernel";
			arch = "arm";
			os = "linux";
			compression = "none";
			load = <0x8000>;
			entry = <0x8000>;
			hash@1 {
				algo = "md5";
			};
		};

		ramdisk@0 {
			description = "ramdisk";
			data = /incbin/("./rootfs.cpio");
			type = "ramdisk";
			arch = "arm";
			os = "linux";
			compression = "none";
			load = <00000000>;
			entry = <00000000>;
			hash@1 {
				algo = "sha1";
			};
		};
	};

	configurations {
		default = "config@1";
		config@1 {
			description = "Linux";
			kernel = "linux_kernel@0";
			fdt = "fdt@0";
			ramdisk = "ramdisk@0";
			fpga = "fpga@0";
		};

		//                config@2 {
		//                        description = "Linux with fpga";
		//                        kernel = "linux_kernel@0";
		//                        fdt = "fdt@0";
		//                        fpga = "fpga@0";
		//                };
	};
};
```
